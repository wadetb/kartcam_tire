## app/build/Kconfig/Kconfig.modules
```kconfig
config ZEPHYR_KARTCAM_TIRE_MODULE
	bool
	default y
menu "cmsis_6 (/home/wadeb/kartcam_zephyr/modules/hal/cmsis_6)"
osource "$(ZEPHYR_CMSIS_6_KCONFIG)"
config ZEPHYR_CMSIS_6_MODULE
	bool
	default y
endmenu
menu "hal_nordic (/home/wadeb/kartcam_zephyr/modules/hal/nordic)"
osource "$(ZEPHYR_HAL_NORDIC_KCONFIG)"
config ZEPHYR_HAL_NORDIC_MODULE
	bool
	default y

config ZEPHYR_HAL_NORDIC_MODULE_BLOBS
	bool
endmenu
menu "segger (/home/wadeb/kartcam_zephyr/modules/debug/segger)"
osource "$(ZEPHYR_SEGGER_KCONFIG)"
config ZEPHYR_SEGGER_MODULE
	bool
	default y
endmenu
```

## app/build/Kconfig/Kconfig.sysbuild.modules
```kconfig
config ZEPHYR_KARTCAM_TIRE_MODULE
   bool
   default y
config ZEPHYR_CMSIS_6_MODULE
   bool
   default y
config ZEPHYR_HAL_NORDIC_MODULE
   bool
   default y
config ZEPHYR_SEGGER_MODULE
   bool
   default y
```

## dts/bindings/sensor/kartcam,lis3dh-spi.yaml
```yaml
description: |
  KartCam LIS3DH binding

compatible: "kartcam,lis3dh-spi"

include:
  - name: spi-device.yaml

properties:
  int-gpios:
    type: phandle-array
    description: Interrupt GPIO from the sensor
    required: false
```

## dts/bindings/sensor/kartcam,lis3dhtr-spi.yaml
```yaml
description: |
  KartCam LIS3DHTR binding

compatible: "kartcam,lis3dhtr-spi"

include:
  - name: spi-device.yaml

properties:
  int-gpios:
    type: phandle-array
    description: Interrupt GPIO from the sensor
    required: false
```
