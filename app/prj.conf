## CMakeLists.txt
```
cmake_minimum_required(VERSION 3.13.1)
find_package(Zephyr REQUIRED HINTS $ENV{ZEPHYR_BASE})

project(app LANGUAGES C)

target_sources(app PRIVATE src/main.c src/channel.c src/spi.c src/dps368.c src/lis3dh.c)
```

## prj.conf
```kconfig
CONFIG_ASSERT=y
CONFIG_USE_SEGGER_RTT=y
CONFIG_RTT_CONSOLE=y
CONFIG_UART_CONSOLE=n
CONFIG_LOG=y
# CONFIG_LOG_DEFAULT_LEVEL=4
CONFIG_LOG_DEFAULT_LEVEL=3
CONFIG_LOG_MAX_LEVEL=4
# CONFIG_LOG_BACKEND_RTT=y
CONFIG_PRINTK=y
CONFIG_CBPRINTF_FP_SUPPORT=y

CONFIG_SHELL=y
CONFIG_SHELL_BACKEND_RTT=y
CONFIG_SHELL_LOG_BACKEND=y
# CONFIG_SHELL_BACKEND_SERIAL=y

# CONFIG_MEMFAULT=y
# CONFIG_MEMFAULT_NCS_PROJECT_KEY="L7yjTlryQ6xzHGbo5tzpN9atOysJlUpr"
# CONFIG_MEMFAULT_NCS_FW_TYPE="app"
# CONFIG_MEMFAULT_NCS_DEVICE_ID="test-device"

CONFIG_ENTROPY_GENERATOR=y

CONFIG_PM_DEVICE=y
CONFIG_POWEROFF=y
CONFIG_HWINFO=y

CONFIG_STACK_USAGE=y

CONFIG_CLOCK_CONTROL_NRF=y
CONFIG_CLOCK_CONTROL_NRF_K32SRC_RC=n
CONFIG_CLOCK_CONTROL_NRF_K32SRC_XTAL=y

CONFIG_GPIO=y
CONFIG_SPI=y
# CONFIG_SPI_LOG_LEVEL_DBG=y

CONFIG_BT=y
# CONFIG_BT_LOG_LEVEL_DBG=y
CONFIG_BT_PERIPHERAL=y
CONFIG_BT_DEVICE_NAME="KartCam Tire"
# CONFIG_BT_DEVICE_APPEARANCE=0
# CONFIG_BT_MAX_CONN=1
# CONFIG_BT_GATT_CLIENT=n
# CONFIG_BT_GATT_SERVICE_CHANGED=y

# CONFIG_BT_CTLR=y
# CONFIG_BT_LL_SW_SPLIT=y

# CONFIG_BT_SMP=y
# CONFIG_BT_FIXED_PASSKEY=n
```

## debug.conf
```kconfig
CONFIG_DEBUG_OPTIMIZATIONS=y
CONFIG_LOG=y
CONFIG_APP_LOG_LEVEL_DBG=y
```

## src/main.c
```c
#include <zephyr/kernel.h>
#include <zephyr/bluetooth/bluetooth.h>
#include <zephyr/bluetooth/hci.h>
#include <zephyr/bluetooth/conn.h>
#include <zephyr/bluetooth/gatt.h>
#include <zephyr/device.h>
#include <zephyr/drivers/gpio.h>
#include <zephyr/drivers/hwinfo.h>
#include <zephyr/drivers/spi.h>
#include <zephyr/logging/log.h>
#include <zephyr/sys/poweroff.h>

#include <app_version.h>

#include "common.h"

LOG_MODULE_REGISTER(main, CONFIG_LOG_DEFAULT_LEVEL);

#define LED0_NODE DT_NODELABEL(led0)
#define LED1_NODE DT_NODELABEL(led1)
// #define LED2_NODE DT_NODELABEL(led2)
// #define LED3_NODE DT_NODELABEL(led3)

#define BTN0_NODE DT_NODELABEL(btn0)

//
// TODO:
// + Drop packets unless recording.
// + Expose per-channel sample rates via shell commands.
// + Expose recording duration and status via shell command.
// + Explicit sleep command.
// + Save settings to NVM.
// + Reset NVRAM if button held at startup?
// + Use "at least" values as input and map to hardware.
// + Add huffman compression with static dictionaries
// + Follow Micropython framing format with timestamps, etc.
// + Use Zephyr DTS to disable unwanted nRF units - extra SPI etc.
//

//
// SPI example:
//
// https://academy.nordicsemi.com/courses/nrf-connect-sdk-intermediate/lessons/lesson-5-serial-peripheral-interface-spi/topic/zephyr-spi-api/
//

#define SPI_NODE  DT_NODELABEL(spi0)

static const struct gpio_dt_spec led0 = GPIO_DT_SPEC_GET(LED0_NODE, gpios);
static const struct gpio_dt_spec led1 = GPIO_DT_SPEC_GET(LED1_NODE, gpios);
// static const struct gpio_dt_spec led2 = GPIO_DT_SPEC_GET(LED2_NODE, gpios);
// static const struct gpio_dt_spec led3 = GPIO_DT_SPEC_GET(LED3_NODE, gpios);

static const struct device *spi_dev = DEVICE_DT_GET(SPI_NODE);

// /* NUS-like UUIDs (Nordic UART Service) */
// #define BT_UUID_NUS_SERVICE_VAL
// BT_UUID_128_ENCODE(0x6E400001,0xB5A3,0xF393,0xE0A9,0xE50E24DCCA9E) #define BT_UUID_NUS_RX_VAL
// BT_UUID_128_ENCODE(0x6E400002,0xB5A3,0xF393,0xE0A9,0xE50E24DCCA9E) #define BT_UUID_NUS_TX_VAL
// BT_UUID_128_ENCODE(0x6E400003,0xB5A3,0xF393,0xE0A9,0xE50E24DCCA9E)

// static struct bt_uuid_128 nus_uuid     = BT_UUID_INIT_128(BT_UUID_NUS_SERVICE_VAL);
// static struct bt_uuid_128 nus_rx_uuid  = BT_UUID_INIT_128(BT_UUID_NUS_RX_VAL);
// static struct bt_uuid_128 nus_tx_uuid  = BT_UUID_INIT_128(BT_UUID_NUS_TX_VAL);

// /* TX CCC state */
// static void tx_ccc_cfg_changed(const struct bt_gatt_attr *attr, uint16_t value)
// {
// 	ARG_UNUSED(attr);
// 	LOG_INF("TX notify %s", (value == BT_GATT_CCC_NOTIFY) ? "enabled" : "disabled");
// }

// /* RX write handler: receive bytes from central */
// static ssize_t rx_write_cb(struct bt_conn *conn, const struct bt_gatt_attr *attr,
// 			   const void *buf, uint16_t len, uint16_t offset, uint8_t flags)
// {
// 	ARG_UNUSED(conn); ARG_UNUSED(attr); ARG_UNUSED(offset); ARG_UNUSED(flags);
// 	LOG_INF("RX %u bytes", len);
// 	/* echo back via TX notify if enabled */
// 	bt_gatt_notify(conn, attr - 1 /* TX value attr is just before CCC */,
// 	               buf, len);
// 	return len;
// }

// /* GATT: Service with RX (Write Without Resp) and TX (Notify) */
// BT_GATT_SERVICE_DEFINE(nus_svc,
// 	BT_GATT_PRIMARY_SERVICE(&nus_uuid),
// 	/* TX characteristic: notify to central */
// 	BT_GATT_CHARACTERISTIC(&nus_tx_uuid.uuid, BT_GATT_CHRC_NOTIFY, BT_GATT_PERM_NONE, NULL,
// NULL, NULL), 	BT_GATT_CCC(tx_ccc_cfg_changed, BT_GATT_PERM_READ | BT_GATT_PERM_WRITE),
// 	/* RX characteristic: central writes here */
// 	BT_GATT_CHARACTERISTIC(&nus_rx_uuid.uuid, BT_GATT_CHRC_WRITE_WITHOUT_RESP,
// 			       BT_GATT_PERM_WRITE, NULL, rx_write_cb, NULL)
// );

// static void connected(struct bt_conn *conn, uint8_t err)
// {
// 	if (err) { LOG_INF("Conn failed (err %u)", err); return; }
// 	LOG_INF("Connected");
// }

// static void disconnected(struct bt_conn *conn, uint8_t reason)
// {
// 	LOG_INF("Disconnected (reason 0x%02x)", reason);
// }

// BT_CONN_CB_DEFINE(conn_cbs) = {
// 	.connected = connected,
// 	.disconnected = disconnected,
// };

// #define COMPANY_ID_CODE 0x0059

// typedef struct adv_mfg_data {
// 	uint16_t company_code; /* Company Identifier Code. */
// 	uint16_t number_press; /* Number of times Button 1 is pressed */
// } adv_mfg_data_type;

// static adv_mfg_data_type adv_mfg_data = { COMPANY_ID_CODE, 0x00 };

// static const struct bt_data ad[] = {
// 	/* STEP 4.1.2 - Set the advertising flags */
// 	BT_DATA_BYTES(BT_DATA_FLAGS, BT_LE_AD_NO_BREDR),
// 	/* STEP 4.1.3 - Set the advertising packet data  */
// 	BT_DATA(BT_DATA_NAME_COMPLETE, "KartCam Tire", sizeof("KartCam Tire")-1),
// 	BT_DATA(BT_DATA_MANUFACTURER_DATA, (unsigned char *)&adv_mfg_data, sizeof(adv_mfg_data)),
// };

// static unsigned char url_data[] ={0x17,'/','/','a','c','a','d','e','m','y','.',
//                                  'n','o','r','d','i','c','s','e','m','i','.',
//                                  'c','o','m'};

// static const struct bt_data sd[] = {
// 	/* 4.2.3 Include the URL data in the scan response packet*/
// 	BT_DATA(BT_DATA_URI, url_data,sizeof(url_data)),
// };

// static const struct bt_le_adv_param *adv_param =
// 	BT_LE_ADV_PARAM(BT_LE_ADV_OPT_NONE, /* No options specified */
// 			800, /* Min Advertising Interval 500ms (800*0.625ms) */
// 			801, /* Max Advertising Interval 500.625ms (801*0.625ms) */
// 			NULL); /* Set to NULL for undirected advertising */

int cmd_table_lookup(const struct shell *shell, const char **table, size_t table_size,
		     const char *value)
{
	for (size_t i = 0; i < table_size; i++) {
		if (strcmp(table[i], value) == 0) {
			return (int)i;
		}
	}
	shell_fprintf(shell, SHELL_ERROR, "Invalid argument value: %s\n", value);
	shell_fprintf(shell, SHELL_ERROR, "Valid options are:\n");
	for (size_t i = 0; i < table_size; i++) {
		shell_fprintf(shell, SHELL_ERROR, " %s\n", table[i]);
	}
	return -1;
}

int print_reset_cause(uint32_t reset_cause)
{
	int32_t ret;
	uint32_t supported;

	ret = hwinfo_get_supported_reset_cause((uint32_t *) &supported);

	if (ret || !(reset_cause & supported)) {
		return -ENOTSUP;
	}

	if (reset_cause & RESET_DEBUG) {
		LOG_INF("Reset by debugger.\n");
	} else if (reset_cause & RESET_CLOCK) {
		LOG_INF("Wakeup from System OFF by GRTC.\n");
	} else if (reset_cause & RESET_LOW_POWER_WAKE) {
		LOG_INF("Wakeup from System OFF by GPIO.\n");
	} else  {
		LOG_INF("Other wake up cause 0x%08X.\n", reset_cause);
	}

	return 0;
}

const struct gpio_dt_spec btn0 = GPIO_DT_SPEC_GET(BTN0_NODE, gpios);
struct gpio_callback btn0_gpio_cb;
K_EVENT_DEFINE(btn0_event);

static void btn0_int_handler(const struct device *port, struct gpio_callback *cb, uint32_t pins)
{
	ARG_UNUSED(port);
	ARG_UNUSED(cb);
	ARG_UNUSED(pins);

	k_event_post(&btn0_event, 1);
}

int main(void)
{
	k_msleep(100); // settle power

	LOG_INF("KartCam Tire Sensor bring-up");

	uint32_t reset_cause;
	hwinfo_get_reset_cause(&reset_cause);
	print_reset_cause(reset_cause);

	gpio_pin_configure_dt(&led0, GPIO_OUTPUT_INACTIVE);
	gpio_pin_configure_dt(&led1, GPIO_OUTPUT_INACTIVE);

	gpio_pin_configure_dt(&btn0, GPIO_INPUT);
	gpio_pin_interrupt_configure_dt(&btn0, GPIO_INT_EDGE_TO_ACTIVE);

	gpio_init_callback(&btn0_gpio_cb, btn0_int_handler, BIT(btn0.pin));
	gpio_add_callback(btn0.port, &btn0_gpio_cb);

	// int err;

	// err = bt_enable(NULL);
	// if (err) {
	// 	LOG_ERR("Bluetooth init failed (err %d)\n", err);
	// 	return -1;
	// }
	// LOG_INF("Bluetooth initialized\n");

	// err = bt_le_adv_start(BT_LE_ADV_NCONN, ad, ARRAY_SIZE(ad), sd, ARRAY_SIZE(sd));
	// if (err) {
	// 	LOG_ERR("Advertising failed to start (err %d)\n", err);
	// 	return -1;
	// }

	// for (;;)
	// {
	// 	k_msleep(100);
	// }

	// /* Advertise: connectable + UUID in scan response */
	// const struct bt_data ad[] = {
	// 	BT_DATA_BYTES(BT_DATA_FLAGS, (BT_LE_AD_GENERAL | BT_LE_AD_NO_BREDR)),
	// 	BT_DATA(BT_DATA_NAME_COMPLETE, "KartCam Tire", sizeof("KartCam Tire")-1),
	// };
	// const struct bt_data sd[] = {
	// 	BT_DATA_BYTES(BT_DATA_UUID128_ALL, BT_UUID_NUS_SERVICE_VAL),
	// };

	// err = bt_le_adv_start(BT_LE_ADV_CONN_NAME, ad, ARRAY_SIZE(ad), sd, ARRAY_SIZE(sd));
	// if (err) {
	// 	LOG_ERR("Adv start failed (%d)", err);
	// }
	// LOG_INF("Advertising 'KartCam Tire'");

	if (!device_is_ready(spi_dev)) {
		LOG_WRN("SPI master device not ready!\n");
	}

	lis3dh_init();
	dps368_init();

	for (;;)
	{
		gpio_pin_set_dt(&led0, 0);
		gpio_pin_set_dt(&led1, 0);

		bool record = false;

		for (int n = 10; n >= 0; n--) {
			gpio_pin_toggle_dt(&led0);

			LOG_INF("sleep in %d seconds...", n);

			// float x, y, z;
			// lis3dh_latest(&x, &y, &z);
			// LOG_INF("  accel: x=%f mg, y=%f mg, z=%f mg", (double)x, (double)y, (double)z);

			uint32_t events = k_event_wait(&btn0_event, 0xFFF, true, K_MSEC(1000));
			if (events & 1) {
				LOG_INF("button pressed!");
				k_msleep(10);
				record = true;
			}

			if (record) {
				break;
			}
		}

		if (!record) {
			break;
		}

		LOG_INF("recording...");

		gpio_pin_set_dt(&led0, 0);
		gpio_pin_set_dt(&led1, 1);

		uint32_t record_ms = 15 * 60 * 1000;
		uint32_t events = k_event_wait(&btn0_event, 0xFFF, true, K_MSEC(record_ms));
		if (events & 1) {
			LOG_INF("button pressed!");
			k_msleep(10);
		}
	}

	gpio_pin_set_dt(&led0, 0);
	gpio_pin_set_dt(&led1, 0);
	dps368_stop();

	LOG_INF("entering deep sleep, wake on interrupt");
	k_msleep(100);

	lis3dh_wake_on_z();
	hwinfo_clear_reset_cause();
	sys_poweroff();	

	return 0;
}
```

## src/channel.c
```c
#include "common.h"

//
// https://github.com/rygorous/gaffer_net/blob/master/main.cpp
// https://go-compression.github.io/algorithms/arithmetic/
// https://github.com/WangXuan95/TinyZZZ/blob/main/src/lz4C.c
// https://github.com/rygorous/ryg_rans - PD, bugs
// https://github.com/pcodec/pcodec - APACHE
// https://github.com/Cyan4973/FiniteStateEntropy - BSD
// https://github.com/samtools/htscodecs
// https://encode.su/threads/2078-List-of-Asymmetric-Numeral-Systems-implementations
// https://www.reddit.com/r/compression/comments/12v7mkt/worries_about_tans/
// https://cbloomrants.blogspot.com/2023/07/float-to-int-casts-for-data-compression.html
// https://cbloomrants.blogspot.com/2023/07/notes-on-float-and-multi-byte-delta.html
// https://aras-p.info/blog/2023/01/29/Float-Compression-0-Intro/
//

//
// TODO:
// + compression, easiest would be just using a hardcoded huffman table, also try rans, delta
// massaging
// + buffer channels to create larger packets, reducing header overhead and improving compression
// + for extra packet security we could store a 16 bit sequence number and ensure as we drop, we drop every packet
// + could also do a simple checksum on packets
//

LOG_MODULE_REGISTER(channel);
// LOG_MODULE_REGISTER(channel, LOG_LEVEL_DBG);

struct packet_header {
	uint16_t timestamp;
	enum channel channel;
	enum quantize quant;
	uint16_t rate;
	uint16_t len;
	uint8_t data[];
};

#define PACKET_BUFFER_SIZE 32768
uint8_t packet_buffer[PACKET_BUFFER_SIZE];
uint32_t buffer_size = PACKET_BUFFER_SIZE;
uint32_t write_pos;
uint32_t read_pos;
uint32_t wrap_pos = PACKET_BUFFER_SIZE;
int32_t last_sample;

uint64_t first_timestamp;
uint64_t last_timestamp;

K_MUTEX_DEFINE(packet_mutex);

const char *channel_names[] = {"null", "accel.x", "accel.y", "accel.z", "temperature", "pressure"};
const char *quantize_names[] = {"1.0", "0.1", "0.01", "0.001", "0.0001"};
const float quantize_factors[] = {1.0f, 0.1f, 0.01f, 0.001f, 0.0001f};

static bool is_valid_packet(struct packet_header *packet)
{
	if (packet->channel >= CHANNEL_COUNT) {
		return false;
	}
	if (packet->quant >= QUANTIZE_COUNT) {
		return false;
	}
	if (packet->rate == 0) {
		return false;
	}
	if (packet->len == 0 || packet->len > 1024) {
		return false;
	}
	return true;
}

static void check_packet(struct packet_header *packet)
{
	if (is_valid_packet(packet)) {
		return;
	}

	uint32_t pos = (uint8_t *)packet - packet_buffer;

	LOG_ERR("bad packet at %u: channel=%#x quant=%#x rate=%#x len=%#x", pos, packet->channel,
		packet->quant, packet->rate, packet->len);

	k_oops();
}

static struct packet_header *packet_at(uint32_t pos)
{
	if (pos >= wrap_pos) {
		LOG_ERR("bad packet position: %u (wrap at %u)", pos, wrap_pos);
		k_oops();
	}
	struct packet_header *packet = (struct packet_header *)(packet_buffer + pos);
	check_packet(packet);
	return packet;
}

static struct packet_header *first_packet()
{
	if (read_pos == write_pos) {
		return NULL;
	}
	return packet_at(read_pos);
}

static struct packet_header *next_packet(struct packet_header *packet)
{
	check_packet(packet);
	uint32_t pos = (uint8_t *)packet - packet_buffer;
	pos += sizeof(struct packet_header) + packet->len;
	pos = (pos + 3) & ~3; // align to 4 bytes
	if (pos == wrap_pos) {
		pos = 0;
	}
	if (pos == write_pos) {
		return NULL;
	}
	return packet_at(pos);
}

static void drop_packet()
{
	struct packet_header *packet = packet_at(read_pos);

	LOG_DBG("dropping packet %s len=%d at %u", channel_names[packet->channel], packet->len,
		read_pos);

	first_timestamp += packet->timestamp;

	read_pos += sizeof(struct packet_header) + packet->len;
	read_pos = (read_pos + 3) & ~3; // align to 4 bytes

	if (read_pos == wrap_pos) {
		read_pos = 0;
	}
}

bool channel_start_packet(enum channel ch, enum quantize quant, uint64_t ts, uint16_t rate,
			  uint16_t sample_count)
{
	k_mutex_lock(&packet_mutex, K_FOREVER);

	uint32_t reserve_size = sizeof(struct packet_header) + sample_count * 4; // worst case size
	reserve_size = (reserve_size + 3) & ~3;                                  // align to 4 bytes

	LOG_DBG("reserve packet channel=%s samples=%d reserve_size=%u write_pos=%u read_pos=%u "
		"wrap_pos=%u",
		channel_names[ch], sample_count, reserve_size, write_pos, read_pos, wrap_pos);

	if (write_pos + reserve_size > buffer_size) {
		LOG_DBG("wrapping packet buffer at %u", write_pos);

		if (read_pos > write_pos) {
			while (read_pos != 0) {
				drop_packet();
			}
            drop_packet();
        }

		wrap_pos = write_pos;
		write_pos = 0;
	}

    while (read_pos > write_pos && read_pos < write_pos + reserve_size) {
        drop_packet();
    }

	LOG_DBG("new packet channel=%s samples=%d at %u", channel_names[ch], sample_count,
		write_pos);

	memset(packet_buffer + write_pos, 0, reserve_size);

	struct packet_header *packet = (struct packet_header *)(packet_buffer + write_pos);

	packet->timestamp = ts - last_timestamp;
	packet->channel = ch;
	packet->quant = quant;
	packet->rate = rate;
	packet->len = 0;

	last_timestamp = ts;
	last_sample = 0;

	return true;
}

void channel_add_packet_sample(float s)
{
	struct packet_header *packet = (struct packet_header *)(packet_buffer + write_pos);

	float sq = s * quantize_factors[packet->quant];
	float t = (sq >= 0.0f) ? 0.5f : -0.5f;
	int32_t si = (int32_t)(sq + t);
	int32_t d = si - last_sample;

	if (d >= 127 || d < -128) {
		uint32_t us = (uint32_t)(si + 32768); // make unsigned for transmission
		packet->data[packet->len++] = 0xff;
		packet->data[packet->len++] = (us >> 8) & 0xff;
		packet->data[packet->len++] = us & 0xff;
	} else {
		packet->data[packet->len++] = (uint8_t)(d + 128);
	}

	last_sample = si;
}

void channel_finish_packet()
{
	struct packet_header *packet = (struct packet_header *)(packet_buffer + write_pos);

	LOG_DBG("finishing packet channel=%s len=%d at %u", channel_names[packet->channel],
		packet->len, write_pos);

	write_pos += sizeof(struct packet_header) + packet->len;
	write_pos = (write_pos + 3) & ~3; // align to 4 bytes

	LOG_DBG("new write_packet at %u", write_pos);

	k_mutex_unlock(&packet_mutex);
}

uint64_t channel_timestamp()
{
	return k_uptime_get_32();
}

static int cmd_channel_buffer_size(const struct shell *shell, size_t argc, char *argv[])
{
	uint32_t new_size = strtoul(argv[1], NULL, 0);
	if (new_size < 256 || new_size > PACKET_BUFFER_SIZE) {
		shell_fprintf(shell, SHELL_ERROR, "invalid buffer size: %u (min 256 max %u)\n",
			      new_size, PACKET_BUFFER_SIZE);
		return -1;
	}

	k_mutex_lock(&packet_mutex, K_FOREVER);
	buffer_size = new_size;
	write_pos = 0;
	read_pos = 0;
	wrap_pos = buffer_size;
	k_mutex_unlock(&packet_mutex);

	shell_fprintf(shell, SHELL_NORMAL, "channel buffer size is now %u\n", buffer_size);
	return 0;
}

static int cmd_channel_log(const struct shell *shell, size_t argc, char *argv[])
{
	k_mutex_lock(&packet_mutex, K_FOREVER);

	uint64_t timestamp = first_timestamp;

	for (struct packet_header *packet = first_packet(); packet != NULL;
	     packet = next_packet(packet)) {
		timestamp += packet->timestamp;
		shell_fprintf(shell, SHELL_NORMAL, "ts=%llu ch=%s quant=%s rate=%u len=%u\n",
			      timestamp, channel_names[packet->channel],
			      quantize_names[packet->quant], packet->rate, packet->len);
	}

	k_mutex_unlock(&packet_mutex);
	return 0;
}

static int cmd_channel_status(const struct shell *shell, size_t argc, char *argv[])
{
	k_mutex_lock(&packet_mutex, K_FOREVER);

	uint32_t time_window = channel_timestamp() - first_timestamp;

	uint32_t buffer_used;
	if (read_pos > write_pos) {
		buffer_used = (wrap_pos - read_pos) + write_pos;
	} else {
		buffer_used = write_pos - read_pos;
	}

	shell_fprintf(shell, SHELL_NORMAL, "buffer status:\n");
	shell_fprintf(shell, SHELL_NORMAL, " buffer_size: %u\n", buffer_size);
	shell_fprintf(shell, SHELL_NORMAL, " buffer_used: %u\n", buffer_used);
	shell_fprintf(shell, SHELL_NORMAL, " time_window: %u\n", time_window);

	shell_fprintf(shell, SHELL_NORMAL, "channel status:\n");
	for (int ch = 0; ch < CHANNEL_COUNT; ch++) {
		uint32_t packet_count = 0;
		uint32_t byte_count = 0;
		for (struct packet_header *packet = first_packet(); packet != NULL;
		     packet = next_packet(packet)) {
			if (packet->channel == ch) {
				packet_count++;
				byte_count += packet->len;
			}
		}
		float packets_per_sec =
			(time_window > 0) ? (packet_count * 1000.0f / time_window) : 0.0f;
		float bytes_per_sec =
			(time_window > 0) ? (byte_count * 1000.0f / time_window) : 0.0f;
		shell_fprintf(shell, SHELL_NORMAL,
			      " %s: packets=%u bytes=%u packets/sec=%.2f bytes/sec=%.2f\n",
			      channel_names[ch], packet_count, byte_count, (double)packets_per_sec,
			      (double)bytes_per_sec);
	}

	k_mutex_unlock(&packet_mutex);
	return 0;
}

static void channel_test_thread_main(void *, void *, void *)
{
	for (;;) {
        uint64_t timestamp = channel_timestamp();
        uint32_t count = sys_rand32_get() % 100 + 1;
        uint32_t samples_per_sec = 999;
        if (channel_start_packet(CHANNEL_NULL, QUANTIZE_1_0, timestamp,
                samples_per_sec, count)) {
            for (int i = 0; i < count; i++) {
                channel_add_packet_sample(i);
            }
            channel_finish_packet();
        }

        k_msleep(sys_rand32_get() % 100 + 1);
	}
}

K_THREAD_STACK_DEFINE(channel_test_thread_stack, 256);
struct k_thread channel_test_thread;

static int cmd_channel_start_test(const struct shell *shell, size_t argc, char *argv[])
{
    k_thread_create(&channel_test_thread, channel_test_thread_stack,
        K_THREAD_STACK_SIZEOF(channel_test_thread_stack),
        channel_test_thread_main,
        NULL, NULL, NULL,
        7, 0, K_NO_WAIT);

    shell_fprintf(shell, SHELL_NORMAL, "channel test started\n");
    return 0;
}

static int cmd_channel_stop_test(const struct shell *shell, size_t argc, char *argv[])
{
    k_thread_abort(&channel_test_thread);

    shell_fprintf(shell, SHELL_NORMAL, "channel test stopped\n");
    return 0;
}

SHELL_STATIC_SUBCMD_SET_CREATE(
	channel_cmds,
	SHELL_CMD_ARG(buffer_size, NULL, "set buffer size", cmd_channel_buffer_size, 2, 0),
	SHELL_CMD_ARG(log, NULL, "print packets in buffer", cmd_channel_log, 1, 0),
	SHELL_CMD_ARG(status, NULL, "print channels status", cmd_channel_status, 1, 0),
    SHELL_CMD_ARG(start_test, NULL, "start channel test", cmd_channel_start_test, 1, 0),
    SHELL_CMD_ARG(stop_test, NULL, "stop channel test", cmd_channel_stop_test, 1, 0),
	SHELL_SUBCMD_SET_END);

SHELL_CMD_REGISTER(channel, &channel_cmds, "Sensor channel commands", NULL);
```

## src/common.h
```c
#ifndef COMMON_H
#define COMMON_H

#include <zephyr/kernel.h>
#include <zephyr/device.h>
#include <zephyr/drivers/spi.h>
#include <zephyr/logging/log.h>
#include <zephyr/random/random.h>
#include <zephyr/shell/shell.h>

#include <math.h>
#include <stdbool.h>
#include <stdint.h>
#include <stdlib.h>

enum channel
{
    CHANNEL_NULL,
    CHANNEL_ACCEL_X,
    CHANNEL_ACCEL_Y,
    CHANNEL_ACCEL_Z,
    CHANNEL_TEMPERATURE,
    CHANNEL_PRESSURE,
    CHANNEL_COUNT
};

enum quantize
{
    QUANTIZE_1_0,
    QUANTIZE_0_1,
    QUANTIZE_0_01,
    QUANTIZE_0_001,
    QUANTIZE_0_0001,
    QUANTIZE_COUNT
};

extern const char *quantize_names[QUANTIZE_COUNT];
#define QUANTIZE_HELP "1.0|0.1|0.01|0.001|0.0001"

int cmd_table_lookup(const struct shell *shell, const char **table, size_t table_size, const char *value);

uint8_t spi_read_uint8(const struct spi_dt_spec *spec, uint8_t reg);
void spi_write_uint8(const struct spi_dt_spec *spec, uint8_t reg, uint8_t val);

uint64_t channel_timestamp();

bool channel_start_packet(enum channel ch, enum quantize quant, uint64_t ts, uint16_t rate, uint16_t sample_count);
void channel_add_packet_sample(float s);
void channel_finish_packet();

void dps368_init(void);
void dps368_latest(float *temperature, float *pressure);
void dps368_stop(void);

void lis3dh_init(void);
void lis3dh_latest(float *x, float *y, float *z);
void lis3dh_wake_on_z(void);

#endif
```

## src/dps368.c
```c
#include "common.h"

//
// TODO:
// + Fix fifo overrun logging
// + Use P and T shift
// + Adjust sleep timers for oversampling?
//

LOG_MODULE_REGISTER(dps368);

#define DPS368_REG_PRS_B2                       0x00
#define DPS368_REG_PRS_B1                       0x01
#define DPS368_REG_PRS_B0                       0x02

#define DPS368_REG_PRS_CFG                      0x06

#define DPS368_REG_TMP_CFG                      0x07
#define DPS368_REG_TMP_CFG_TMP_EXT              BIT(7)

#define DPS368_REG_MEAS_CFG                     0x08
#define DPS368_REG_MEAS_CFG_MEAS_CTRL_CONT_BOTH BIT_MASK(3)
#define DPS368_REG_MEAS_CFG_COEFF_RDY           BIT(7)

#define DPS368_REG_CFG_REG                      0x09
#define DPS368_REG_CFG_REG_FIFO_EN              0x02
#define DPS368_REG_CFG_REG_P_SHIFT              0x04
#define DPS368_REG_CFG_REG_T_SHIFT              0x08

#define DPS368_REG_FIFO_STS                     0x0B
#define DPS368_REG_FIFO_STS_FIFO_FULL           BIT(1)

#define DPS368_REG_PRODUCT_ID                   0x0D
#define DPS368_REG_COEF                         0x10

enum dps368_rate {
	DPS368_RATE_1_HZ,
	DPS368_RATE_2_HZ,
	DPS368_RATE_4_HZ,
	DPS368_RATE_8_HZ,
	DPS368_RATE_16_HZ,
	DPS368_RATE_32_HZ,
	DPS368_RATE_64_HZ,
	DPS368_RATE_128_HZ
};

enum dps368_oversampling {
	DPS368_OSR_1,
	DPS368_OSR_2,
	DPS368_OSR_4,
	DPS368_OSR_8,
	DPS368_OSR_16,
	DPS368_OSR_32,
	DPS368_OSR_64,
	DPS368_OSR_128
};

#define DPS368_NODE DT_NODELABEL(dps368)

#define DPS368_OP                                                                                  \
	SPI_OP_MODE_MASTER | SPI_MODE_CPOL | SPI_MODE_CPHA | SPI_WORD_SET(8) | SPI_LINES_SINGLE

struct spi_dt_spec dps368 = SPI_DT_SPEC_GET(DPS368_NODE, DPS368_OP);

static float c0Half, c1;
static float c00, c10, c20, c30;
static float c01, c11, c21;

const float dps368_scaling_facts[] = {524288.0f, 1572864.0f, 3670016.0f, 7864320.0f,
				      253952.0f, 516096.0f,  1040384.0f, 2088960.0f};

enum dps368_rate dps368_prs_rate = DPS368_RATE_64_HZ;
enum dps368_rate dps368_tmp_rate = DPS368_RATE_8_HZ;

enum dps368_oversampling dps368_tmp_osr = DPS368_OSR_1;
enum dps368_oversampling dps368_prs_osr = DPS368_OSR_1;

enum quantize dps368_tmp_quant = QUANTIZE_0_1;
enum quantize dps368_prs_quant = QUANTIZE_0_1;

uint8_t dps368_watermark = 30;

float dps368_latest_tmp_sc;
float dps368_latest_tmp_comp;
float dps368_latest_prs_comp;

static uint32_t dps368_samples_per_sec(enum dps368_rate rate)
{
	return 1 << rate;
}

static int32_t twoc(uint32_t value, uint8_t bits)
{
	if (value & (1u << (bits - 1))) {
		value = value - (1u << bits);
	}
	return (int32_t)value;
}

static void dps368_read_fifo()
{
	// LOG_INF("dps368_read_fifo");

	// FIXME- not working?
	// uint8_t fifo_sts = spi_read_uint8(&dps368, DPS368_REG_FIFO_STS);
	// if (fifo_sts & DPS368_REG_FIFO_STS_FIFO_FULL)
	// {
	//     LOG_WRN("fifo overrun");
	// }

	int prs_count = 0;
	int tmp_count = 0;
	float prs_buf[32];
	float tmp_buf[32];

	for (;;) {
		uint8_t value[3];
		value[0] = spi_read_uint8(&dps368, DPS368_REG_PRS_B2);
		value[1] = spi_read_uint8(&dps368, DPS368_REG_PRS_B1);
		value[2] = spi_read_uint8(&dps368, DPS368_REG_PRS_B0);

		// LOG_INF("raw bytes: %02x %02x %02x", value[0], value[1], value[2]);

		if (value[0] == 0x80 && value[1] == 0x00 && value[2] == 0x00) {
			break;
		}

		uint32_t mode = value[2] & 1;

		int32_t raw = 0;
		raw |= (uint32_t)value[0] << 16;
		raw |= (uint32_t)value[1] << 8;
		raw |= (uint32_t)value[2] & 0xfe;
		raw = twoc(raw, 24);
		// LOG_INF("raw: %x", raw);

		if (mode) {
			int32_t prs_raw = raw;
			float prs_sc = (float)prs_raw / dps368_scaling_facts[dps368_prs_osr];
			float prs_comp =
				c00 + prs_sc * (c10 + prs_sc * (c20 + prs_sc * c30)) +
				dps368_latest_tmp_sc * (c01 + prs_sc * (c11 + prs_sc * c21));
			// LOG_INF("prs_raw: %x prs_sc: %f prs_comp: %f", prs_raw, (double)prs_sc,
			// (double)prs_comp);
			prs_buf[prs_count] = prs_comp;
			prs_count++;
			dps368_latest_prs_comp = prs_comp;
		} else {
			int32_t tmp_raw = raw;
			float tmp_sc = (float)tmp_raw / dps368_scaling_facts[dps368_tmp_osr];
			float tmp_comp = c0Half + c1 * tmp_sc;
			// LOG_INF("tmp_raw: %x tmp_sc: %f tmp_comp: %f", tmp_raw, (double)tmp_sc,
			// (double)tmp_comp);
			tmp_buf[tmp_count] = tmp_comp;
			tmp_count++;
			dps368_latest_tmp_sc = tmp_sc;
			dps368_latest_tmp_comp = tmp_comp;
		}
	}

	uint64_t timestamp = channel_timestamp();

	if (prs_count > 0) {
		uint32_t samples_per_sec = dps368_samples_per_sec(dps368_prs_rate);
		if (channel_start_packet(CHANNEL_PRESSURE, dps368_prs_quant, timestamp, samples_per_sec,
				 prs_count)) {
			for (int i = 0; i < prs_count; i++) {
				channel_add_packet_sample(prs_buf[i]);
			}
			channel_finish_packet();
		}
	}

	if (tmp_count > 0) {
		uint32_t samples_per_sec = dps368_samples_per_sec(dps368_tmp_rate);
		if (channel_start_packet(CHANNEL_TEMPERATURE, dps368_tmp_quant, timestamp,
				 samples_per_sec, tmp_count)) {
			for (int i = 0; i < tmp_count; i++) {
				channel_add_packet_sample(tmp_buf[i]);
			}
			channel_finish_packet();
		}
	}
}

K_THREAD_STACK_DEFINE(dps368_thread_stack, 1024);
struct k_thread dps368_thread;

static void dps368_thread_main(void *, void *, void *)
{
	while (1) {
		uint32_t prs_samples_per_sec = dps368_samples_per_sec(dps368_prs_rate);
		uint32_t tmp_samples_per_sec = dps368_samples_per_sec(dps368_tmp_rate);
		uint32_t sleep_usec =
			dps368_watermark * 1000000 / (prs_samples_per_sec + tmp_samples_per_sec);
		// LOG_INF("sleep_usec: %d", sleep_usec);
		k_usleep(sleep_usec);

		dps368_read_fifo();
	}
}

static void dps368_read_coefs(void)
{
	uint8_t coef[18];
	for (int i = 0; i < 18; i++) {
		coef[i] = spi_read_uint8(&dps368, DPS368_REG_COEF + i);
	}
	// spi_read_buf(&dps368, DPS368_REG_COEF, 18, coef);

	c0Half = twoc(((uint32_t)coef[0] << 4) | (((uint32_t)coef[1] >> 4) & 0x0F), 12) / 2;
	c1 = twoc((((uint32_t)coef[1] & 0x0F) << 8) | (uint32_t)coef[2], 12);

	c00 = twoc(((uint32_t)coef[3] << 12) | ((uint32_t)coef[4] << 4) |
			   (((uint32_t)coef[5] >> 4) & 0x0F),
		   20);
	c10 = twoc((((uint32_t)coef[5] & 0x0F) << 16) | ((uint32_t)coef[6] << 8) |
			   (uint32_t)coef[7],
		   20);

	c01 = twoc(((uint32_t)coef[8] << 8) | (uint32_t)coef[9], 16);
	c11 = twoc(((uint32_t)coef[10] << 8) | (uint32_t)coef[11], 16);
	c20 = twoc(((uint32_t)coef[12] << 8) | (uint32_t)coef[13], 16);
	c21 = twoc(((uint32_t)coef[14] << 8) | (uint32_t)coef[15], 16);
	c30 = twoc(((uint32_t)coef[16] << 8) | (uint32_t)coef[17], 16);

	LOG_INF("c0Half: %f c1: %f", (double)c0Half, (double)c1);
	LOG_INF("c00: %f c10: %f c20: %f c30: %f", (double)c00, (double)c10, (double)c20,
		(double)c30);
	LOG_INF("c01: %f c11: %f c21: %f", (double)c01, (double)c11, (double)c21);
}

static void dps368_config(void)
{
	uint8_t tmpcfg = dps368_tmp_osr | (dps368_tmp_rate << 4) | DPS368_REG_TMP_CFG_TMP_EXT;
	uint8_t prscfg = dps368_prs_osr | (dps368_prs_rate << 4);
	uint8_t cfg_reg = DPS368_REG_CFG_REG_FIFO_EN;
	uint8_t meas_cfg = DPS368_REG_MEAS_CFG_MEAS_CTRL_CONT_BOTH;

	spi_write_uint8(&dps368, DPS368_REG_TMP_CFG, tmpcfg);
	spi_write_uint8(&dps368, DPS368_REG_PRS_CFG, prscfg);
	spi_write_uint8(&dps368, DPS368_REG_CFG_REG, cfg_reg);
	spi_write_uint8(&dps368, DPS368_REG_MEAS_CFG, meas_cfg);
}

void dps368_init(void)
{
	uint8_t id = spi_read_uint8(&dps368, DPS368_REG_PRODUCT_ID);
	if (id != 0x10) {
		LOG_ERR("device not detected!");
		return;
	}

	dps368_read_coefs();
	dps368_config();

	k_thread_create(&dps368_thread, dps368_thread_stack,
			K_THREAD_STACK_SIZEOF(dps368_thread_stack), dps368_thread_main, NULL, NULL,
			NULL, 7, 0, K_NO_WAIT);

	LOG_INF("initialized");
}

void dps368_latest(float *temperature, float *pressure)
{
	*temperature = dps368_latest_tmp_comp;
	*pressure = dps368_latest_prs_comp;
}

void dps368_stop(void)
{
	k_thread_abort(&dps368_thread);

	spi_write_uint8(&dps368, DPS368_REG_TMP_CFG, 0);
	spi_write_uint8(&dps368, DPS368_REG_PRS_CFG, 0);
	spi_write_uint8(&dps368, DPS368_REG_CFG_REG, 0);
	spi_write_uint8(&dps368, DPS368_REG_MEAS_CFG, 0);
}

static const char *dps368_rate_names[] = {
	"1hz", "2hz", "4hz", "8hz", "16hz", "32hz", "64hz", "128hz",
};

static const char *dps368_osr_names[] = {
	"1", "2", "4", "8", "16", "32", "64", "128",
};

static int cmd_dps368_tmp_rate(const struct shell *shell, size_t argc, char *argv[])
{
	int index =
		cmd_table_lookup(shell, dps368_rate_names, ARRAY_SIZE(dps368_rate_names), argv[1]);
	if (index < 0) {
		return -1;
	}
	dps368_tmp_rate = (enum dps368_rate)index;
	dps368_config();
	return 0;
}

static int cmd_dps368_prs_rate(const struct shell *shell, size_t argc, char *argv[])
{
	int index =
		cmd_table_lookup(shell, dps368_rate_names, ARRAY_SIZE(dps368_rate_names), argv[1]);
	if (index < 0) {
		return -1;
	}
	dps368_prs_rate = (enum dps368_rate)index;
	dps368_config();
	return 0;
}

static int cmd_dps368_tmp_osr(const struct shell *shell, size_t argc, char *argv[])
{
	int index =
		cmd_table_lookup(shell, dps368_osr_names, ARRAY_SIZE(dps368_osr_names), argv[1]);
	if (index < 0) {
		return -1;
	}
	dps368_tmp_osr = (enum dps368_oversampling)index;
	dps368_config();
	return 0;
}

static int cmd_dps368_prs_osr(const struct shell *shell, size_t argc, char *argv[])
{
	int index =
		cmd_table_lookup(shell, dps368_osr_names, ARRAY_SIZE(dps368_osr_names), argv[1]);
	if (index < 0) {
		return -1;
	}
	dps368_prs_osr = (enum dps368_oversampling)index;
	dps368_config();
	return 0;
}

static int cmd_dps368_tmp_quant(const struct shell *shell, size_t argc, char *argv[])
{
	int index = cmd_table_lookup(shell, quantize_names, QUANTIZE_COUNT, argv[1]);
	if (index < 0) {
		return -1;
	}
	dps368_tmp_quant = (enum quantize)index;
	return 0;
}

static int cmd_dps368_prs_quant(const struct shell *shell, size_t argc, char *argv[])
{
	int index = cmd_table_lookup(shell, quantize_names, QUANTIZE_COUNT, argv[1]);
	if (index < 0) {
		return -1;
	}
	dps368_prs_quant = (enum quantize)index;
	return 0;
}

static int cmd_dps368_status(const struct shell *shell, size_t argc, char *argv[])
{
	shell_fprintf(shell, SHELL_NORMAL, "DPS368 status:\n");
	shell_fprintf(shell, SHELL_NORMAL, " tmp_rate: %s\n", dps368_rate_names[dps368_tmp_rate]);
	shell_fprintf(shell, SHELL_NORMAL, " prs_rate: %s\n", dps368_rate_names[dps368_prs_rate]);
	shell_fprintf(shell, SHELL_NORMAL, " tmp_osr: %s\n", dps368_osr_names[dps368_tmp_osr]);
	shell_fprintf(shell, SHELL_NORMAL, " prs_osr: %s\n", dps368_osr_names[dps368_prs_osr]);
	return 0;
}

SHELL_STATIC_SUBCMD_SET_CREATE(
	dps368_cmds,
	SHELL_CMD_ARG(tmp_rate, NULL, "1hz|2hz|4hz|8hz|16hz|32hz|64hz|128hz", cmd_dps368_tmp_rate,
		      2, 0),
	SHELL_CMD_ARG(prs_rate, NULL, "1hz|2hz|4hz|8hz|16hz|32hz|64hz|128hz", cmd_dps368_prs_rate,
		      2, 0),
	SHELL_CMD_ARG(tmp_osr, NULL, "1|2|4|8|16|32|64|128", cmd_dps368_tmp_osr, 2, 0),
	SHELL_CMD_ARG(prs_osr, NULL, "1|2|4|8|16|32|64|128", cmd_dps368_prs_osr, 2, 0),
	SHELL_CMD_ARG(tmp_quant, NULL, QUANTIZE_HELP, cmd_dps368_tmp_quant, 2, 0),
	SHELL_CMD_ARG(prs_quant, NULL, QUANTIZE_HELP, cmd_dps368_prs_quant, 2, 0),
	SHELL_CMD_ARG(status, NULL, "print device status", cmd_dps368_status, 1, 0),
	SHELL_SUBCMD_SET_END);

SHELL_CMD_REGISTER(dps368, &dps368_cmds, "DPS368 Digital XENSIV(TM) barometric pressure sensor",
		   NULL);
```

## src/dps368.h
```c
#ifndef DPS368_H
#define DPS368_H

#include <stdint.h>

#define DPS368_REG_PRS_B2 (0x00) // Pressure data byte 2
#define DPS368_REG_PRS_B1 (0x01) // Pressure data byte 1
#define DPS368_REG_PRS_B0 (0x02) // Pressure data byte 0
#define DPS368_REG_TMP_B2 (0x03) // Temperature data byte 2
#define DPS368_REG_TMP_B1 (0x04) // Temperature data byte 1
#define DPS368_REG_TMP_B0 (0x05) // Temperature data byte 0
#define DPS368_REG_PRS_CFG (0x06) // Pressure configuration register
#define DPS368_REG_TMP_CFG (0x07) // Temperature configuration register
#define DPS368_REG_MEAS_CFG (0x08) // Measurement configuration register
#define DPS368_REG_CFG_REG (0x09) // Configuration register
#define DPS368_REG_INT_STS (0x0A) // Interrupt and status register
#define DPS368_REG_FIFO_STS (0x0B) // FIFO status register
#define DPS368_REG_RESET (0x0C) // Reset register
#define DPS368_REG_PRODUCT_ID (0x0D) // Product ID register
#define DPS368_REG_COEF (0x10) // Coefficient start register
#define DPS368_REG_COEF_SRCE (0x28) // Coefficient source register

#define DPS368_REG_PRS_CFG_PRC_MASK (0x07)
#define DPS368_REG_PRS_CFG_PRC_1 (0x00)
#define DPS368_REG_PRS_CFG_PRC_2 (0x01)
#define DPS368_REG_PRS_CFG_PRC_4 (0x02)
#define DPS368_REG_PRS_CFG_PRC_8 (0x03)
#define DPS368_REG_PRS_CFG_PRC_16 (0x04)
#define DPS368_REG_PRS_CFG_PRC_32 (0x05)
#define DPS368_REG_PRS_CFG_PRC_64 (0x06)
#define DPS368_REG_PRS_CFG_PRC_128 (0x07)
#define DPS368_REG_PRS_CFG_RATE_MASK (0x70)
#define DPS368_REG_PRS_CFG_RATE_1 (0x00)
#define DPS368_REG_PRS_CFG_RATE_2 (0x10)
#define DPS368_REG_PRS_CFG_RATE_4 (0x20)
#define DPS368_REG_PRS_CFG_RATE_8 (0x30)
#define DPS368_REG_PRS_CFG_RATE_16 (0x40)
#define DPS368_REG_PRS_CFG_RATE_32 (0x50)
#define DPS368_REG_PRS_CFG_RATE_64 (0x60)
#define DPS368_REG_PRS_CFG_RATE_128 (0x70)

#define DPS368_REG_TMP_CFG_PRC_MASK (0x07)
#define DPS368_REG_TMP_CFG_PRC_1 (0x00)
#define DPS368_REG_TMP_CFG_PRC_2 (0x01)
#define DPS368_REG_TMP_CFG_PRC_4 (0x02)
#define DPS368_REG_TMP_CFG_PRC_8 (0x03)
#define DPS368_REG_TMP_CFG_PRC_16 (0x04)
#define DPS368_REG_TMP_CFG_PRC_32 (0x05)
#define DPS368_REG_TMP_CFG_PRC_64 (0x06)
#define DPS368_REG_TMP_CFG_PRC_128 (0x07)
#define DPS368_REG_TMP_CFG_RATE_MASK (0x70)
#define DPS368_REG_TMP_CFG_RATE_1 (0x00)
#define DPS368_REG_TMP_CFG_RATE_2 (0x10)
#define DPS368_REG_TMP_CFG_RATE_4 (0x20)
#define DPS368_REG_TMP_CFG_RATE_8 (0x30)
#define DPS368_REG_TMP_CFG_RATE_16 (0x40)
#define DPS368_REG_TMP_CFG_RATE_32 (0x50)
#define DPS368_REG_TMP_CFG_RATE_64 (0x60)
#define DPS368_REG_TMP_CFG_RATE_128 (0x70)
#define DPS368_REG_TMP_CFG_TMP_EXT (0x80)

#define DPS368_REG_MEAS_CFG_MEAS_CTRL_MASK (0x07)
#define DPS368_REG_MEAS_CFG_MEAS_CTRL_IDLE (0x00)
#define DPS368_REG_MEAS_CFG_MEAS_CTRL_CMD_PRS (0x01)
#define DPS368_REG_MEAS_CFG_MEAS_CTRL_CMD_TMP (0x02)
#define DPS368_REG_MEAS_CFG_MEAS_CTRL_CONT_PRS (0x05)
#define DPS368_REG_MEAS_CFG_MEAS_CTRL_CONT_TMP (0x06)
#define DPS368_REG_MEAS_CFG_MEAS_CTRL_CONT_BOTH (0x07)
#define DPS368_REG_MEAS_CFG_PRS_RDY (0x10)
#define DPS368_REG_MEAS_CFG_TMP_RDY (0x20)
#define DPS368_REG_MEAS_CFG_SENSOR_RDY (0x40)
#define DPS368_REG_MEAS_CFG_COEFF_RDY (0x80)

#define DPS368_REG_CFG_REG_SPI_MODE_3WIRE (0x01)
#define DPS368_REG_CFG_REG_FIFO_EN (0x02)
#define DPS368_REG_CFG_REG_P_SHIFT (0x04)
#define DPS368_REG_CFG_REG_T_SHIFT (0x08)
#define DPS368_REG_CFG_REG_INT_PRS (0x10)
#define DPS368_REG_CFG_REG_INT_TMP (0x20)
#define DPS368_REG_CFG_REG_INT_FIFO (0x40)
#define DPS368_REG_CFG_REG_INT_HL (0x80)

#define DPS368_REG_INT_STS_PRS_RDY (0x01)
#define DPS368_REG_INT_STS_TMP_RDY (0x02)
#define DPS368_REG_INT_STS_FIFO_FULL (0x04)

#define DPS368_REG_FIFO_STS_FIFO_EMPTY (0x01)
#define DPS368_REG_FIFO_STS_FIFO_FULL (0x02)

#define DPS368_REG_RESET_SOFT_RESET (0x09)
#define DPS368_REG_RESET_FIFO_FLUSH (0x80)

#define DPS368_REG_PRODUCT_ID_PROD_ID_MASK (0x0F)
#define DPS368_REG_PRODUCT_ID_REV_ID_MASK (0xF0)

#define DPS368_REG_TMP_COEF_SRCE_TEMP_SENSOR_EXTERNAL (0x80)
#define DPS368_REG_TMP_COEF_SRCE_TEMP_SENSOR_INTERNAL (0x00)

void dps368_init(void);
void dps368_latest(float *temperature, float *pressure);

#endif
```

## src/lis3dh.c
```c
#include "common.h"

LOG_MODULE_REGISTER(lis3dh);

#define LIS3DH_REG_WHO_AM_I            0x0F

#define LIS3DH_REG_CTRL_REG1           0x20
#define LIS3DH_REG_CTRL_REG1_LPEN      BIT(3)
#define LIS3DH_REG_CTRL_REG1_ZEN       BIT(2)
#define LIS3DH_REG_CTRL_REG1_YEN       BIT(1)
#define LIS3DH_REG_CTRL_REG1_XEN       BIT(0)

#define LIS3DH_REG_CTRL_REG2           0x21

#define LIS3DH_REG_CTRL_REG3           0x22
#define LIS3DH_REG_CTRL_REG3_I1_IA1    BIT(6)

#define LIS3DH_REG_CTRL_REG4           0x23
#define LIS3DH_REG_CTRL_REG4_HR        BIT(3)

#define LIS3DH_REG_CTRL_REG5           0x24
#define LIS3DH_REG_CTRL_REG5_FIFO_EN   BIT(6)

#define LIS3DH_REG_CTRL_REG6           0x25
#define LIS3DH_REG_REFERENCE           0x26
#define LIS3DH_REG_STATUS_REG          0x27

#define LIS3DH_REG_OUT_X_L             0x28

#define LIS3DH_REG_FIFO_CTRL           0x2E
#define LIS3DH_REG_FIFO_CTRL_FM_BYPASS 0
#define LIS3DH_REG_FIFO_CTRL_FM_FIFO   BIT(6)

#define LIS3DH_REG_FIFO_SRC            0x2F

#define LIS3DH_REG_INT1_CFG            0x30
#define LIS3DH_REG_INT1_CFG_ZHIE       BIT(5)
#define LIS3DH_REG_INT1_CFG_ZLIE       BIT(4)
#define LIS3DH_REG_INT1_CFG_YHIE       BIT(3)
#define LIS3DH_REG_INT1_CFG_YLIE       BIT(2)
#define LIS3DH_REG_INT1_CFG_XHIE       BIT(1)
#define LIS3DH_REG_INT1_CFG_XLIE       BIT(0)

#define LIS3DH_REG_INT1_SRC            0x31
#define LIS3DH_REG_INT1_THS            0x32
#define LIS3DH_REG_INT1_DURATION       0x33

enum lis3dh_rate {
	LIS3DH_RATE_0_HZ, // Power-down mode
	LIS3DH_RATE_1_HZ,
	LIS3DH_RATE_10_HZ,
	LIS3DH_RATE_25_HZ,
	LIS3DH_RATE_50_HZ,
	LIS3DH_RATE_100_HZ,
	LIS3DH_RATE_200_HZ,
	LIS3DH_RATE_400_HZ,
	LIS3DH_RATE_1_6_KHZ,
	LIS3DH_RATE_5_KHZ
};

enum lis3dh_mode {
	LIS3DH_MODE_LOW_POWER,
	LIS3DH_MODE_NORMAL,
	LIS3DH_MODE_HIGH_RES
};

enum lis3dh_scale {
	LIS3DH_SCALE_2G,
	LIS3DH_SCALE_4G,
	LIS3DH_SCALE_8G,
	LIS3DH_SCALE_16G
};

#define LIS3DH_NODE DT_NODELABEL(lis3dh)

#define LIS3DH_OP                                                                                  \
	SPI_OP_MODE_MASTER | SPI_MODE_CPOL | SPI_MODE_CPHA | SPI_WORD_SET(8) | SPI_LINES_SINGLE

const struct spi_dt_spec lis3dh = SPI_DT_SPEC_GET(LIS3DH_NODE, LIS3DH_OP);
const struct gpio_dt_spec lis3dh_int = GPIO_DT_SPEC_GET(LIS3DH_NODE, int_gpios);

struct gpio_callback lis3dh_gpio_cb;

enum lis3dh_mode lis3dh_mode = LIS3DH_MODE_HIGH_RES;
enum lis3dh_scale lis3dh_scale = LIS3DH_SCALE_2G;
enum lis3dh_rate lis3dh_rate = LIS3DH_RATE_100_HZ;
enum quantize lis3dh_quant = QUANTIZE_0_1;
uint8_t lis3dh_watermark = 30;

uint16_t lis3dh_z_wakeup_thr = 1200;
uint16_t lis3dh_z_wakeup_dur = 0;

float lis3dh_latest_x;
float lis3dh_latest_y;
float lis3dh_latest_z;

static float lis3dh_mg_per_lsb_table[] = {0.0625f, 0.125f, 0.25f, 0.75f};
static uint16_t lis3dh_samples_per_sec_table[] = {0, 1, 10, 25, 50, 100, 200, 400, 1600, 5000};

static void lis3dh_read_fifo(int samples, bool log)
{
	// LOG_INF("lis3dh_read_fifo: samples=%d", samples);

	uint8_t len = 1 + samples * 3 * sizeof(int16_t);
	uint8_t tx_buf[len];
	uint8_t rx_buf[len];

	tx_buf[0] = LIS3DH_REG_OUT_X_L | 0x80 | 0x40;

	struct spi_buf tx0 = {.buf = tx_buf, .len = len};
	struct spi_buf rx0 = {.buf = rx_buf, .len = len};
	struct spi_buf_set txs = {.buffers = &tx0, .count = 1};
	struct spi_buf_set rxs = {.buffers = &rx0, .count = 1};

	spi_transceive_dt(&lis3dh, &txs, &rxs);

	spi_write_uint8(&lis3dh, LIS3DH_REG_FIFO_CTRL, LIS3DH_REG_FIFO_CTRL_FM_BYPASS);
	spi_write_uint8(&lis3dh, LIS3DH_REG_FIFO_CTRL,
			LIS3DH_REG_FIFO_CTRL_FM_FIFO | lis3dh_watermark);

	// LOG_INF("reading %d samples from fifo, log_size=%d", samples);

	float mg_scale = lis3dh_mg_per_lsb_table[lis3dh_scale];
	// LOG_INF("mg_scale %f", (double)mg_scale);

	uint64_t timestamp = channel_timestamp();
	uint32_t samples_per_sec = lis3dh_samples_per_sec_table[lis3dh_rate];

	// Errata: we skip the first sample of each FIFO as it's consistently invalid.

	if (channel_start_packet(CHANNEL_ACCEL_X, lis3dh_quant, timestamp, samples_per_sec,
				 samples - 1)) {
		for (int i = 1; i < samples; i++) {
			int offset = 1 + i * 6;
			int16_t value = (int16_t)(rx_buf[offset + 1] << 8 | rx_buf[offset + 0]);
			lis3dh_latest_x = value * mg_scale;
			channel_add_packet_sample(lis3dh_latest_x);
		}
		channel_finish_packet();
	}

	if (channel_start_packet(CHANNEL_ACCEL_Y, lis3dh_quant, timestamp, samples_per_sec,
				 samples - 1)) {
		for (int i = 1; i < samples; i++) {
			int offset = 1 + i * 6;
			int16_t value = (int16_t)(rx_buf[offset + 3] << 8 | rx_buf[offset + 2]);
			lis3dh_latest_y = value * mg_scale;
			channel_add_packet_sample(lis3dh_latest_y);
		}
		channel_finish_packet();
	}

	if (channel_start_packet(CHANNEL_ACCEL_Z, lis3dh_quant, timestamp, samples_per_sec,
				 samples - 1)) {
		for (int i = 1; i < samples; i++) {
			int offset = 1 + i * 6;
			int16_t value = (int16_t)(rx_buf[offset + 5] << 8 | rx_buf[offset + 4]);
			lis3dh_latest_z = value * mg_scale;
			channel_add_packet_sample(lis3dh_latest_z);
		}
		channel_finish_packet();
	}
}

static void lis3dh_thread_main(void *, void *, void *)
{
	for (;;) {
		uint32_t samples_per_sec = lis3dh_samples_per_sec_table[lis3dh_rate];
		// LOG_INF("samples_per_sec: %d", samples_per_sec);
		uint32_t fifo_fill_usec =
			samples_per_sec ? lis3dh_watermark * 1000000 / samples_per_sec : 1000000;
		// LOG_INF("fifo_fill_usec: %d", fifo_fill_usec);
		k_usleep(fifo_fill_usec);

		uint8_t fifo_src = spi_read_uint8(&lis3dh, LIS3DH_REG_FIFO_SRC);
		uint8_t ovrn_fifo = fifo_src & 0x40;
		uint8_t fss = fifo_src & 0x1F;
		// uint8_t wtm = fifo_src & 0x80;
		// uint8_t empty = fifo_src & 0x20;
		// LOG_INF("FIFO_SRC: 0x%02x wtm=%x ovrn_fifo=%x empty=%x, fss=%x", fifo_src, wtm,
		// ovrn_fifo, empty, fss);

		if (ovrn_fifo) {
			LOG_WRN("fifo overrun");
		}

		if (fss > 0) {
			lis3dh_read_fifo(fss, true);
		}
	}
}

K_THREAD_STACK_DEFINE(lis3dh_thread_stack, 1024);
struct k_thread lis3dh_thread;

static void lis3dh_config(void)
{
	uint8_t ctrl_reg1 = (lis3dh_rate << 4) | LIS3DH_REG_CTRL_REG1_ZEN |
			    LIS3DH_REG_CTRL_REG1_YEN | LIS3DH_REG_CTRL_REG1_XEN |
			    (lis3dh_mode == LIS3DH_MODE_LOW_POWER ? LIS3DH_REG_CTRL_REG1_LPEN : 0);
	uint8_t ctrl_reg4 = (lis3dh_scale << 4) |
			    (lis3dh_mode == LIS3DH_MODE_HIGH_RES ? LIS3DH_REG_CTRL_REG4_HR : 0);
	uint8_t ctrl_reg5 = LIS3DH_REG_CTRL_REG5_FIFO_EN;
	uint8_t fifo_ctrl = LIS3DH_REG_FIFO_CTRL_FM_FIFO | lis3dh_watermark;

	spi_write_uint8(&lis3dh, LIS3DH_REG_CTRL_REG1, ctrl_reg1);
	spi_write_uint8(&lis3dh, LIS3DH_REG_CTRL_REG2, 0);
	spi_write_uint8(&lis3dh, LIS3DH_REG_CTRL_REG3, 0);
	spi_write_uint8(&lis3dh, LIS3DH_REG_CTRL_REG4, ctrl_reg4);
	spi_write_uint8(&lis3dh, LIS3DH_REG_CTRL_REG5, ctrl_reg5);
	spi_write_uint8(&lis3dh, LIS3DH_REG_CTRL_REG6, 0);
	spi_write_uint8(&lis3dh, LIS3DH_REG_FIFO_CTRL, fifo_ctrl);
	spi_write_uint8(&lis3dh, LIS3DH_REG_INT1_CFG, 0);
	spi_write_uint8(&lis3dh, LIS3DH_REG_INT1_THS, 0);
	spi_write_uint8(&lis3dh, LIS3DH_REG_INT1_DURATION, 0);

	lis3dh_read_fifo(32, false); // Drain and discard any existing samples in FIFO
}

void lis3dh_init(void)
{
	uint8_t id = spi_read_uint8(&lis3dh, LIS3DH_REG_WHO_AM_I);
	if (id != 0x33) {
		LOG_ERR("device not detected!");
		return;
	}

	lis3dh_config();

	k_thread_create(&lis3dh_thread, lis3dh_thread_stack,
			K_THREAD_STACK_SIZEOF(lis3dh_thread_stack), lis3dh_thread_main, NULL, NULL,
			NULL, 7, 0, K_NO_WAIT);

	LOG_INF("initialized");
}

void lis3dh_latest(float *x, float *y, float *z)
{
	*x = lis3dh_latest_x;
	*y = lis3dh_latest_y;
	*z = lis3dh_latest_z;
}

volatile uint8_t lis3dh_int_triggered;

static void lis3dh_int_handler(const struct device *port, struct gpio_callback *cb, uint32_t pins)
{
	ARG_UNUSED(port);
	ARG_UNUSED(cb);
	ARG_UNUSED(pins);

	// uint8_t int_src = spi_read_uint8(&lis3dh, LIS3DH_REG_INT1_SRC);
	// LOG_INF("INT triggered by %x", int_src);

	lis3dh_int_triggered = 1;

	// LOG_INF("inttttt %d", lis3dh_int_triggered);
}

void lis3dh_wake_on_z(void)
{
	k_thread_abort(&lis3dh_thread);
	lis3dh_read_fifo(32, false); // Drain and discard any existing samples in FIFO

	spi_read_uint8(&lis3dh, LIS3DH_REG_INT1_SRC); // Clear any pending interrupts

	gpio_pin_configure_dt(&lis3dh_int, GPIO_INPUT);
	gpio_pin_interrupt_configure_dt(&lis3dh_int, GPIO_INT_LEVEL_ACTIVE);

	gpio_init_callback(&lis3dh_gpio_cb, lis3dh_int_handler, BIT(lis3dh_int.pin));
	gpio_add_callback(lis3dh_int.port, &lis3dh_gpio_cb);

	spi_write_uint8(&lis3dh, LIS3DH_REG_CTRL_REG1,
			(LIS3DH_RATE_1_HZ << 4) | LIS3DH_REG_CTRL_REG1_ZEN |
				LIS3DH_REG_CTRL_REG1_LPEN);
	spi_write_uint8(&lis3dh, LIS3DH_REG_CTRL_REG2, 0);
	spi_write_uint8(&lis3dh, LIS3DH_REG_CTRL_REG3, LIS3DH_REG_CTRL_REG3_I1_IA1);
	spi_write_uint8(&lis3dh, LIS3DH_REG_CTRL_REG4, LIS3DH_SCALE_4G << 4);
	spi_write_uint8(&lis3dh, LIS3DH_REG_CTRL_REG5, 0);
	spi_write_uint8(&lis3dh, LIS3DH_REG_CTRL_REG6, 0);
	spi_write_uint8(&lis3dh, LIS3DH_REG_FIFO_CTRL, 0);
	spi_write_uint8(&lis3dh, LIS3DH_REG_INT1_CFG, LIS3DH_REG_INT1_CFG_ZHIE);
	spi_write_uint8(&lis3dh, LIS3DH_REG_INT1_THS, lis3dh_z_wakeup_thr / 32);
	spi_write_uint8(&lis3dh, LIS3DH_REG_INT1_DURATION, lis3dh_z_wakeup_dur);

	spi_read_uint8(&lis3dh, LIS3DH_REG_INT1_SRC); // One more clear pending
}

static const char *lis3dh_mode_names[] = {"low_power", "normal", "high_res"};
static const char *lis3dh_scale_names[] = {"2g", "4g", "8g", "16g"};
static const char *lis3dh_rate_names[] = {"0hz",   "1hz",   "10hz",  "25hz",   "50hz",
					  "100hz", "200hz", "400hz", "1.6khz", "5khz"};

static int cmd_lis3dh_mode(const struct shell *shell, size_t argc, char *argv[])
{
	int index =
		cmd_table_lookup(shell, lis3dh_mode_names, ARRAY_SIZE(lis3dh_mode_names), argv[1]);
	if (index < 0) {
		return -1;
	}
	lis3dh_mode = (enum lis3dh_mode)index;
	lis3dh_config();
	return 0;
}

static int cmd_lis3dh_scale(const struct shell *shell, size_t argc, char *argv[])
{
	int index = cmd_table_lookup(shell, lis3dh_scale_names, ARRAY_SIZE(lis3dh_scale_names),
				     argv[1]);
	if (index < 0) {
		return -1;
	}
	lis3dh_scale = (enum lis3dh_scale)index;
	lis3dh_config();
	return 0;
}

static int cmd_lis3dh_rate(const struct shell *shell, size_t argc, char *argv[])
{
	int index =
		cmd_table_lookup(shell, lis3dh_rate_names, ARRAY_SIZE(lis3dh_rate_names), argv[1]);
	if (index < 0) {
		return -1;
	}
	lis3dh_rate = (enum lis3dh_rate)index;
	lis3dh_config();
	return 0;
}

static int cmd_lis3dh_quant(const struct shell *shell, size_t argc, char *argv[])
{
	int index = cmd_table_lookup(shell, quantize_names, QUANTIZE_COUNT, argv[1]);
	if (index < 0) {
		return -1;
	}
	lis3dh_quant = (enum quantize)index;
	return 0;
}

static int cmd_lis3dh_status(const struct shell *shell, size_t argc, char *argv[])
{
	shell_fprintf(shell, SHELL_NORMAL, "LIS3DH status:\n");
	shell_fprintf(shell, SHELL_NORMAL, " mode: %s\n", lis3dh_mode_names[lis3dh_mode]);
	shell_fprintf(shell, SHELL_NORMAL, " scale: %s\n", lis3dh_scale_names[lis3dh_scale]);
	shell_fprintf(shell, SHELL_NORMAL, " rate: %s\n", lis3dh_rate_names[lis3dh_rate]);
	shell_fprintf(shell, SHELL_NORMAL, " quant: %s\n", quantize_names[lis3dh_quant]);
	return 0;
}

SHELL_STATIC_SUBCMD_SET_CREATE(
	lis3dh_cmds, SHELL_CMD_ARG(mode, NULL, "low_power|normal|high_res", cmd_lis3dh_mode, 2, 0),
	SHELL_CMD_ARG(scale, NULL, "2g|4g|8g|16g", cmd_lis3dh_scale, 2, 0),
	SHELL_CMD_ARG(rate, NULL, "0hz|1hz|10hz|25hz|50hz|100hz|200hz|400hz|1.6khz|5khz",
		      cmd_lis3dh_rate, 2, 0),
	SHELL_CMD_ARG(quant, NULL, QUANTIZE_HELP, cmd_lis3dh_quant, 2, 0),
	SHELL_CMD_ARG(status, NULL, "print device status", cmd_lis3dh_status, 1, 0),
	SHELL_SUBCMD_SET_END);

SHELL_CMD_REGISTER(lis3dh, &lis3dh_cmds, "LIS3DH MEMS 3-axis \"nano\" accelerometer", NULL);
```
